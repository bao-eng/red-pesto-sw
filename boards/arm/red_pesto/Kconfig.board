## boards/arm/red_pesto/Kconfig.board
```kconfig
# Copyright (c) 2021 Yonatan Schachter
# SPDX-License-Identifier: Apache-2.0

config BOARD_RED_PESTO
	bool "Red Pesto Board"
	depends on SOC_RP2040
```
